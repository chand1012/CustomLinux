## build/conf/bblayers.conf
```bitbake
# POKY_BBLAYERS_CONF_VERSION is increased each time build/conf/bblayers.conf
# changes incompatibly
POKY_BBLAYERS_CONF_VERSION = "2"

BBPATH = "${TOPDIR}"
BBFILES ?= ""

BBLAYERS ?= " \
  /media/data/jenkins/workspace/Custom-Yocto-x86/sources/poky/meta \
  /media/data/jenkins/workspace/Custom-Yocto-x86/sources/poky/meta-poky \
  /media/data/jenkins/workspace/Custom-Yocto-x86/sources/poky/meta-yocto-bsp \
  /media/data/jenkins/workspace/Custom-Yocto-x86/sources/meta-openembedded/meta-python \
  /media/data/jenkins/workspace/Custom-Yocto-x86/sources/meta-openembedded/meta-gnome \
  /media/data/jenkins/workspace/Custom-Yocto-x86/sources/meta-openembedded/meta-networking \
  /media/data/jenkins/workspace/Custom-Yocto-x86/sources/meta-openembedded/meta-oe \
  /media/data/jenkins/workspace/Custom-Yocto-x86/sources/meta-intel \
  "

  
```
